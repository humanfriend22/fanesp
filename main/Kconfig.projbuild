## main/Kconfig.projbuild
```kconfig
menu "FanESP Configuration"

    config FANESP_WIFI_SSID
        string "WiFi SSID"
        default "myssid"
        help
            WiFi network name.

    config FANESP_WIFI_PASSWORD
        string "WiFi Password"
        default "mypassword"
        help
            WiFi password.

    config FANESP_MDNS_HOSTNAME
        string "mDNS hostname"
        default "esp"
        help
            Device accessible at <hostname>.local

endmenu
```

## sdkconfig.defaults
```kconfig
CONFIG_BT_ENABLED=y
CONFIG_BT_NIMBLE_ENABLED=y
CONFIG_BT_NIMBLE_ROLE_OBSERVER=y
CONFIG_BT_NIMBLE_ROLE_CENTRAL=y
CONFIG_PARTITION_TABLE_SINGLE_APP_LARGE=y
```
